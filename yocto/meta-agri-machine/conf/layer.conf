## yocto/meta-agri-machine/conf/layer.conf
```bitbake
# We have a conf and classes directory, add to BBPATH
BBPATH .= ":${LAYERDIR}"

# We have recipes-* directories, add to BBFILES
BBFILES += "${LAYERDIR}/recipes-*/*/*.bb \
            ${LAYERDIR}/recipes-*/*/*.bbappend"

BBFILE_COLLECTIONS += "agri-machine"
BBFILE_PATTERN_agri-machine = "^${LAYERDIR}/"
BBFILE_PRIORITY_agri-machine = "6"

LAYERVERSION_agri-machine = "1"
LAYERSERIES_COMPAT_agri-machine = "kirkstone mickledore nanbield scarthgap"
```
